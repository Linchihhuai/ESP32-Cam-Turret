## esp32-cam-turret/components/app/Kconfig
```kconfig
menu "Turret application"

config APP_SERVO_GPIO
    int "Servo signal GPIO"
    range 0 39
    default 14
    help
        GPIO connected to the servo signal wire. Confirm it is available on
        your board and is not shared with an enabled peripheral.

endmenu
```

## esp32-cam-turret/components/cam/Kconfig.projbuild
```kconfig
menu "Turret camera"

config CAM_ENABLE
    bool "Enable OV5640 camera and MJPEG stream"
    default n
    help
        Enable camera initialization and the MJPEG stream. Leave disabled to
        run the control webpage and servo without starting the camera.

config CAM_PIN_XCLK
    int "Camera XCLK GPIO"
    default 15

config CAM_PIN_PCLK
    int "Camera PCLK GPIO"
    default 13

config CAM_PIN_VSYNC
    int "Camera VSYNC GPIO"
    default 6

config CAM_PIN_HREF
    int "Camera HREF GPIO"
    default 7

config CAM_PIN_D0
    int "Camera D0 / Y2 GPIO"
    default 11

config CAM_PIN_D1
    int "Camera D1 / Y3 GPIO"
    default 9

config CAM_PIN_D2
    int "Camera D2 / Y4 GPIO"
    default 8

config CAM_PIN_D3
    int "Camera D3 / Y5 GPIO"
    default 10

config CAM_PIN_D4
    int "Camera D4 / Y6 GPIO"
    default 12

config CAM_PIN_D5
    int "Camera D5 / Y7 GPIO"
    default 18

config CAM_PIN_D6
    int "Camera D6 / Y8 GPIO"
    default 17

config CAM_PIN_D7
    int "Camera D7 / Y9 GPIO"
    default 16

config CAM_PIN_SIOD
    int "Camera SIOD / SDA GPIO"
    default 4

config CAM_PIN_SIOC
    int "Camera SIOC / SCL GPIO"
    default 5

config CAM_PIN_PWDN
    int "Camera PWDN GPIO (-1 if unused)"
    default -1

config CAM_PIN_RESET
    int "Camera RESET GPIO (-1 if unused)"
    default -1

endmenu
```

## esp32-cam-turret/components/web_ui/Kconfig.projbuild
```kconfig
menu "Turret web control"

config WEB_UI_AP_SSID
    string "Control Wi-Fi network name"
    default "Turret-Control"
    help
        Wi-Fi network name created by the ESP32 for the turret control page.

config WEB_UI_AP_PASSWORD
    string "Control Wi-Fi password"
    default "turret-demo-8264"
    help
        WPA2 password for the ESP32 control network. Use at least 8 characters
        and change the default before deploying outside a trusted test area.

config WEB_UI_STA_SSID
    string "Local Wi-Fi network name (SSID)"
    default ""
    help
        SSID of the 2.4 GHz Wi-Fi network the ESP32 should join. Leave empty
        to use only the ESP32 control network.

config WEB_UI_STA_PASSWORD
    string "Local Wi-Fi password"
    default ""
    help
        Password for the local Wi-Fi network. Leave empty only for an open
        network. Configure credentials locally with menuconfig; do not commit
        them to source control.

endmenu
```
